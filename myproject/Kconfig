## myproject/Kconfig
```kconfig
# SPDX-License-Identifier: GPL-2.0
menu "My project"

source "myproject/syscall/Kconfig"

source "myproject/test/Kconfig"

source "myproject/simple_char/Kconfig"

source "myproject/mmap_devdrv/Kconfig"

source "myproject/sync_lock/Kconfig"

source "myproject/interrupt_test/Kconfig"

source "myproject/debug_test/Kconfig"

source "myproject/myusb_hid/Kconfig"

source "myproject/hid_test/Kconfig"

endmenu
```

## myproject/debug_test/Kconfig
```kconfig
# SPDX_Licnese-Identifier: GPL-2.0

config DEBUG_TEST
    tristate "DEBUG_TEST"
    
```

## myproject/hid_test/Kconfig
```kconfig
# SPDX_Licnese-Identifier: GPL-2.0

config HID_TEST
    tristate "HID_TEST"
    
```

## myproject/interrupt_test/Kconfig
```kconfig
# SPDX_Licnese-Identifier: GPL-2.0

config INTERRUPT_TEST
    tristate "INTERRUPT_TEST"
    
```

## myproject/mmap_devdrv/Kconfig
```kconfig
# SPDX-License-Identifier: GPL-2.0

config MMAP_DEV_DRIVER
    tristate "mmap_devdrv driver"
```

## myproject/myusb_hid/Kconfig
```kconfig
# SPDX_Licnese-Identifier: GPL-2.0

config MYUSB_HID
    tristate "MYUSB_HID"
    
```

## myproject/simple_char/Kconfig
```kconfig
# SPDX_Licnese-Identifier: GPL-2.0

config SIMPLE_CHAR
    tristate "SIMPLE_CHAR"
    
```

## myproject/sync_lock/Kconfig
```kconfig
# SPDX_Licnese-Identifier: GPL-2.0

config SYNC_LOCK
    tristate "SYNC_LOCK"
    
```

## myproject/test/Kconfig
```kconfig
# SPDX-License-Identifier: GPL-2.0

config TEST_DRIVER
    tristate "test driver"
```
